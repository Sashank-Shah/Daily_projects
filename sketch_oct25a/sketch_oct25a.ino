#include <SPI.h>
#include <TinyGPS++.h>
#include <ESP8266WiFi.h>
#include <SoftwareSerial.h>
#include <ESP8266HTTPClient.h>


int httpPort = 80;

String url1 = "/speeddett/insert.php?temp=";
String host = "spectrumcet.com";
//String host = "18.217.222.254";
HTTPClient http;

const char* ssid     = "POCO X2";
const char* password = "Wifijoinkar";


int firstVal, secondVal, thirdVal; // sensors 

static const int RXPin = D8, TXPin = D0;

static const uint32_t GPSBaud = 9600;
// The TinyGPS++ object
TinyGPSPlus gps;

// The serial connection to the GPS device
SoftwareSerial ss(RXPin, TXPin);



#define NUMFLAKES 10
#define XPOS 0
#define YPOS 1
#define DELTAY 2


#define LOGO16_GLCD_HEIGHT 16
#define LOGO16_GLCD_WIDTH  16



static const unsigned char PROGMEM EN_logo [] = {
B00000000, B00000000, B00000000, B00000000, B00000000, B00000000, B00000000, B00000000,
B00000000, B00000000, B00000000, B00000000, B00000000, B00000000, B00000000, B00000000,
B00000000, B00000000, B00000000, B00000000, B00000000, B00000000, B00000000, B00000000,  
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B00000000, B00000000, B00000000, B00000000, B00000000, B00000000, B00000000, B00000000
};


static const unsigned char PROGMEM  LOGO[] =
{
/* 0X00,0X01,0X40,0X00,0X40,0X00, */
0X00,0X00,0X00,0X00,0X00,0X00,0X00,0X00,0X00,0X00,0X00,0X00,0X00,0X00,0X00,0X00,
0X00,0X00,0X00,0X00,0X00,0X00,0X00,0X00,0X00,0X0F,0X00,0X00,0X00,0X00,0X00,0X00,
0X00,0X3F,0XE0,0X00,0X00,0X00,0X00,0X00,0X00,0XFF,0XF0,0X00,0X00,0X00,0X00,0X00,
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0X00,0X00,0X00,0X00,0X00,0X00,0X00,0X00,0X00,0X00,0X00,0X00,0X00,0X00,0X00,0X00,
};

void setup() {
  // put your setup code here, to run once:

   // Debug console
  Serial.begin(9600);
  ss.begin(GPSBaud);
  
  Serial.println();
  Serial.println();
  Serial.print("Connecting to ");
  Serial.println(ssid);
  
  WiFi.begin(ssid, password); 
  while (WiFi.status() != WL_CONNECTED) {
    delay(500);
    Serial.print(".");
  }
  Serial.println("");
  Serial.println("WiFi connected");  
  Serial.println("IP address: ");
  Serial.println(WiFi.localIP());
  Serial.print("Netmask: ");
  Serial.println(WiFi.subnetMask());
  Serial.print("Gateway: ");
  Serial.println(WiFi.gatewayIP());
  

}

double lok;
int sat, minuta, sek,speedv,visina;

void loop() {

  // put your main code here, to run repeatedly:
    Serial.println("GPS NOT FOUND!!!!!!!!!!");
   
   while (ss.available())
   {
      
      if(gps.encode(ss.read())) {
      if (gps.location.isUpdated())
      { 
        speedv = gps.speed.kmph();  
      }
   

  WiFiClient client;
  const int httpPort = 80;
  if (!client.connect(host, httpPort)) {
    Serial.println("connection failed");
    return;
  }
  
 
  String url = "/speeddett/insert.php?temp=" + String(speedv); 

  Serial.print("Requesting URL: ");
  Serial.println(url);

  
  http.begin(host,httpPort,url); 
  int httpCode = http.GET();
  Serial.println(httpCode);

  delay(2000);
  
   }
   
   }

 


 
  
   
}
